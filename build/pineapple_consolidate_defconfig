## build/pineapple_consolidate_defconfig
```kconfig
CONFIG_CNSS2=y
CONFIG_CNSS_OUT_OF_TREE=y
CONFIG_CNSS2_QMI=y
CONFIG_CNSS_QMI_SVC=y
CONFIG_CNSS_GENL=y
CONFIG_BUS_AUTO_SUSPEND=y
CONFIG_CNSS2_SSR_DRIVER_DUMP=y
CONFIG_CNSS_HW_SECURE_DISABLE=y
CONFIG_CNSS2_SMMU_DB_SUPPORT=y
CONFIG_CNSS_PLAT_IPC_QMI_SVC=y
CONFIG_WCNSS_MEM_PRE_ALLOC=y
CONFIG_CNSS_UTILS=y
```
