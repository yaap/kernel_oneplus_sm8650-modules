## oplus/kernel/dfr/Kconfig
```kconfig
# SPDX-License-Identifier: GPL-2.0-only
# Copyright (C) 2018-2022 Oplus. All rights reserved.

#ifdef OPLUS_FEATURE_PMIC_MONITOR
source "drivers/soc/oplus/dfr/qcom/qcom_pmic_monitor/Kconfig"
#endif /* OPLUS_FEATURE_PMIC_MONITOR */

#ifdef OPLUS_FEATURE_QCOM_PMICWD
source "drivers/soc/oplus/dfr/qcom/qcom_pmicwd/Kconfig"
#endif /* OPLUS_FEATURE_QCOM_PMICWD */

#ifdef OPLUS_FEATURE_DUMP_REASON
source "drivers/soc/oplus/dfr/qcom/dump_device_info/Kconfig"
#endif /* OPLUS_FEATURE_DUMP_REASON */

#ifdef OPLUS_FEATURE_DUMP_REASON
source "drivers/soc/oplus/dfr/qcom/dump_reason/Kconfig"
#endif /* OPLUS_FEATURE_DUMP_REASON */

#ifdef OPLUS_FEATURE_KEYEVENT_HANDLER
source "drivers/soc/oplus/dfr/common/keyevent_handler/Kconfig"
#endif /* OPLUS_FEATURE_KEYEVENT_HANDLER */
```

## oplus/kernel/network/oplus_uim2_switch/Kconfig
```kconfig
config OPLUS_UIM2_SWITCH
	tristate "Oplus UIM2 eSIM/SIM2 switch driver"
	depends on OEM_QMI
	default n
	help
	  Provides sysfs control of the UIM2 mux GPIO to switch between
	  eSIM and the second physical SIM slot on Oplus devices with
	  shared UIM2 (e.g. waffle).

	  Write 0 to uim2_state to enable eSIM (default).
	  Write 1 to uim2_state to enable physical SIM2.

	  Depends on the oem_qmi module for UIM QMI power control.
```
